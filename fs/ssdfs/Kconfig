## fs/ssdfs/Kconfig
```kconfig
config SSDFS
	tristate "SSDFS file system support"
	depends on BLOCK || MTD
	help
	  SSDFS is flash-friendly file system. The architecture of
	  file system has been designed to be the LFS file system
	  that can: (1) exclude the GC overhead, (2) prolong NAND
	  flash devices lifetime, (3) achieve a good performance
	  balance even if the NAND flash device's lifetime is a priority.

	  If unsure, say N.

config SSDFS_BLOCK_DEVICE
	bool "Block layer support"
	depends on BLOCK && SSDFS
	depends on BLK_DEV_ZONED
	default y
	help
	  This option enables block layer support.

	  If unsure, say N.

config SSDFS_MTD_DEVICE
	bool "MTD support"
	depends on !SSDFS_BLOCK_DEVICE && MTD && SSDFS
	default n
	help
	  This option enables MTD layer support.

	  If unsure, say N.

config SSDFS_POSIX_ACL
	bool "SSDFS POSIX Access Control Lists"
	depends on SSDFS
	select FS_POSIX_ACL
	help
	  POSIX Access Control Lists (ACLs) support permissions for users and
	  groups beyond the owner/group/world scheme.

	  To learn more about Access Control Lists, visit the POSIX ACLs for
	  Linux website <http://acl.bestbits.at/>.

	  If you don't know what Access Control Lists are, say N

config SSDFS_SECURITY
	bool "SSDFS Security Labels"
	depends on SSDFS
	help
	  Security labels support alternative access control models
	  implemented by security modules like SELinux.  This option
	  enables an extended attribute handler for file security
	  labels in the SSDFS filesystem.

	  If you are not using a security module that requires using
	  extended attributes for file security labels, say N.

menu "Write amplification management"

config SSDFS_ZLIB
	bool "SSDFS ZLIB compression support"
	select ZLIB_INFLATE
	select ZLIB_DEFLATE
	depends on SSDFS
	default y
	help
	  Zlib is designed to be a free, general-purpose, legally unencumbered,
	  lossless data-compression library for use on virtually any computer
	  hardware and operating system. It offers a good trade-off between
	  compression achieved and the amount of CPU time and memory necessary
	  to compress and decompress. See <http://www.gzip.org/zlib/> for
	  further information.

	  If unsure, say Y.

config SSDFS_ZLIB_COMR_LEVEL
	int "Zlib compression level (0 => NO_COMPRESSION, 9 => BEST_COMPRESSION)"
	depends on SSDFS_ZLIB
	range 0 9
	default 9
	help
	  Select Zlib compression level.
	  Examples:
		     0  => Z_NO_COMPRESSION
		     1  => Z_BEST_SPEED
		     9  => Z_BEST_COMPRESSION

config SSDFS_LZO
	bool "SSDFS LZO compression support"
	select LZO_COMPRESS
	select LZO_DECOMPRESS
	depends on SSDFS
	default n
	help
	  minilzo-based compression. Generally works better than Zlib.
	  LZO compression is mainly aimed at embedded systems with slower
	  CPUs where the overheads of zlib are too high.

	  If unsure, say N.

config SSDFS_DIFF_ON_WRITE
	bool "SSDFS Diff-On-Write support"
	depends on SSDFS
	help
	  This option enables delta-encoding support.

	  If unsure, say N.

config SSDFS_DIFF_ON_WRITE_METADATA
	bool "SSDFS Diff-On-Write support (metadata case)"
	depends on SSDFS_DIFF_ON_WRITE
	help
	  This option enables delta-encoding support for metadata.

	  If unsure, say N.

config SSDFS_DIFF_ON_WRITE_METADATA_THRESHOLD
	int "Btree node modification percentage threshold (1% - 50%)"
	range 1 50
	default 25
	depends on SSDFS_DIFF_ON_WRITE_METADATA
	help
	  Select btree node modification percentage threshold as
	  upper bound of modified items in a node.

config SSDFS_DIFF_ON_WRITE_USER_DATA
	bool "SSDFS Diff-On-Write support (user data case)"
	depends on SSDFS_DIFF_ON_WRITE
	help
	  This option enables delta-encoding support for user data.

	  If unsure, say N.

config SSDFS_DIFF_ON_WRITE_USER_DATA_THRESHOLD
	int "Logical block's modified bits percentage threshold (1% - 50%)"
	range 1 50
	default 50
	depends on SSDFS_DIFF_ON_WRITE_USER_DATA
	help
	  Select logical block modification percentage threshold as
	  upper bound of modified bits in the logical block.

endmenu

menu "Performance"

config SSDFS_FIXED_SUPERBLOCK_SEGMENTS_SET
	bool "SSDFS fixed superblock segments set"
	depends on SSDFS
	default y
	help
	  This option enables the technique of repeatable using the
	  reserved set of superblock segments in the beginning
	  of a volume.

	  If unsure, say N.

config SSDFS_SAVE_WHOLE_BLK2OFF_TBL_IN_EVERY_LOG
	bool "Save whole offset translation table in every log"
	depends on SSDFS
	default y
	help
	  This option enables the technique of storing the whole
	  offset translation table in every log. SSDFS can distribute
	  the complete state of ofset translation table among multiple
	  logs. It could decrease amount of metadata in the log.
	  However, this policy increases the amount of read I/O requests
	  because it requires to read multiple log headers in the same
	  erase block. If a big erase block contains a lot of small
	  partial logs then it can degrades file system performance
	  because of significant amount of read I/O during
	  initialization phase.

	  If unsure, say N.

endmenu

menu "Reliability"

config SSDFS_CHECK_LOGICAL_BLOCK_EMPTYNESS
	bool "SSDFS check a logical block emptyness on every write"
	depends on SSDFS
	help
	  This option enables the technique of checking a logical block
	  emptyness on every write. The goal of this technique is
	  to prevent the re-writing pages with existing data because
	  SSD's FTL can manage this sutiation. However, this can be the
	  source of data and metadata corruption in the case of some
	  issues in file system driver logic. But it needs to take into
	  account that this technique could degrade the write performance
	  of file system driver. Also, file system volume has to be erased
	  during creation by mkfs. Otherwise, file system driver will fail
	  to write even for the case correct write operations.

	  If unsure, say N.

config SSDFS_ONLINE_FSCK
	bool "SSDFS online fsck functionality"
	depends on SSDFS
	help
	  This option enables the online FSCK functionality. Every erase
	  block or zone will have a dedicated fsck thread that is triggered
	  after some number of log commit operations. The responsibility of
	  this thread is to check checksums and correctness of metadata
	  structures. If any corruptions have been detected, then the thread
	  will report about it and it will try to recover the corruption(s)
	  in the background.

	  If unsure, say N.

endmenu

menu "Development"

config SSDFS_DEBUG
	bool "SSDFS debugging"
	depends on SSDFS
	help
	  This option enables additional pre-condition and post-condition
	  checking in functions. The main goal of this option is providing
	  environment for debugging code in SSDFS driver and excluding
	  debug checking from end-users' kernel build. This option enables
	  debug output by means of pr_debug() from all files too. You can
	  disable debug output from any file via the 'dynamic_debug/control'
	  file. Please, see Documentation/dynamic-debug-howto.txt for
	  additional information.

	  If you are going to debug SSDFS driver then choose Y here.
	  If unsure, say N.

config SSDFS_TRACK_API_CALL
	bool "SSDFS API calls tracking"
	depends on SSDFS
	help
	  This option enables output from the key subsystems' fucntions.
	  The main goal of this option is providing the vision of
	  file system activity.

	  If you are going to debug SSDFS driver then choose Y here.
	  If unsure, say N.

config SSDFS_MEMORY_LEAKS_ACCOUNTING
	bool "SSDFS memory leaks accounting"
	depends on SSDFS
	help
	  This option enables accounting of memory allocation
	  (kmalloc, kzalloc, kcalloc, kmem_cache_alloc, alloc_page)
	  by means of incrementing a global counters and deallocation
	  (kfree, kmem_cache_free, free_page) by means decrementing
	  the same global counters. Also, there are special global counters
	  that tracking the number of locked/unlocked memory pages.
	  However, global counters have an unpleasant side effect.
	  If there are several mounted SSDFS partitions in the system
	  then memory leaks accounting subsystem is miscalculating
	  the number of memory leaks and triggers false alarms.
	  It makes sense to use the memory leaks accounting subsystem
	  only for single mounted SSDFS partition in the system.

	  If you are going to check memory leaks in SSDFS driver then
	  choose Y here. If unsure, say N.

config SSDFS_SHOW_CONSUMED_MEMORY
	bool "SSDFS shows consumed memory"
	select SSDFS_MEMORY_LEAKS_ACCOUNTING
	help
	  This option enables showing the amount of allocated
	  memory and memory pages in the form of memory leaks
	  on every syncfs event.

	  If you are going to check memory consumption in SSDFS driver
	  then choose Y here. If unsure, say N.

config SSDFS_BTREE_CONSISTENCY_CHECK
	bool "SSDFS btree consistency check"
	depends on SSDFS
	help
	  This option enables checking the btree consistency.

	  If you are going to check btree consistency in SSDFS driver then
	  choose Y here. If unsure, say N.

config SSDFS_BTREE_STRICT_CONSISTENCY_CHECK
	bool "SSDFS btree strict consistency check"
	depends on SSDFS
	help
	  This option enables checking the btree consistency
	  after every btree's operation. This option could
	  seriously degrades the file system performance.

	  If you are going to check btree consistency in SSDFS driver then
	  choose Y here. If unsure, say N.

config SSDFS_TESTING
	bool "SSDFS testing"
	depends on SSDFS
	select SSDFS_DEBUG
	select SSDFS_MEMORY_LEAKS_ACCOUNTING
	select SSDFS_BTREE_CONSISTENCY_CHECK
	help
	  This option enables testing infrastructure of SSDFS
	  filesystem.

	  If you are going to test SSDFS driver then choose Y here.
	  If unsure, say N.

config SSDFS_UNDER_DEVELOPMENT_FUNC
	bool "SSDFS under development functionality"
	depends on SSDFS
	help
	  This option enables functionality that is under
	  development yet.

	  If you are going to check under development functionality
	  in SSDFS driver then choose Y here. If unsure, say N.

endmenu
```
